## config/boards/shields/dactyl6x5/Kconfig.defconfig
```kconfig
if SHIELD_DACTYL6X5_LEFT

config ZMK_KEYBOARD_NAME
    default "dactyl6x5"

config ZMK_SPLIT_ROLE_CENTRAL
    default y

endif

if SHIELD_DACTYL6X5_RIGHT

    config ZMK_KEYBOARD_NAME
        default "TAIKO-DACTYL-R"

endif

if SHIELD_DACTYL6X5_LEFT || SHIELD_DACTYL6X5_RIGHT

    config ZMK_SPLIT
        default y

endif
```

## config/boards/shields/dactyl6x5/Kconfig.shield
```kconfig
config SHIELD_DACTYL6X5_LEFT
    def_bool $(shields_list_contains,dactyl6x5_left)

config SHIELD_DACTYL6X5_RIGHT
    def_bool $(shields_list_contains,dactyl6x5_right)
```
